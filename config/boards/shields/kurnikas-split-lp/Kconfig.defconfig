## config/boards/shields/kurnikas-split-lp/Kconfig.defconfig
```kconfig
if SHIELD_KURNIKAS_SPLIT_LP_LEFT

# Name must be less than 16 characters long!
config ZMK_KEYBOARD_NAME
    default "KurnikasLP"

config ZMK_SPLIT_ROLE_CENTRAL
    default y
endif

if SHIELD_KURNIKAS_SPLIT_LP_LEFT ||SHIELD_KURNIKAS_SPLIT_LP_RIGHT

config ZMK_SPLIT
    default y
endif
```

## config/boards/shields/kurnikas-split-lp/Kconfig.shield
```kconfig
config SHIELD_KURNIKAS_SPLIT_LP_LEFT
    def_bool $(shields_list_contains,kurnikas-split-lp-left)

config SHIELD_KURNIKAS_SPLIT_LP_RIGHT
    def_bool $(shields_list_contains,kurnikas-split-lp-right)
```
