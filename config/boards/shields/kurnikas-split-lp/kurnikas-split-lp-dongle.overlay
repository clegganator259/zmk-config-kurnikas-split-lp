#include <dt-bindings/zmk/matrix_transform.h>
#include "kurnikas-split-lp-layouts.dtsi"

/ {

    mock_kscan: mock_kscan_0 {
        compatible = "zmk,kscan-mock";
        columns = <0>;
        rows = <0>;
        events = <0>;
    };
    chosen {
        zmk,kscan = &mock_kscan;
    };
};
