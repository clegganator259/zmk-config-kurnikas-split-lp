#include "kurnikas-split-lp.dtsi" // The shared dtsi file is included in the overlay

// Label of the kscan node in the dtsi
&kscan0 {
    col-gpios
        = <&nrf52840 9 GPIO_ACTIVE_HIGH>
        , <&nrf52840 6 GPIO_ACTIVE_HIGH>
        , <&nrf52840 5 GPIO_ACTIVE_HIGH>
        , <&nrf52840 4 GPIO_ACTIVE_HIGH>
        , <&nrf52840 3 GPIO_ACTIVE_HIGH>
        , <&nrf52840 0 GPIO_ACTIVE_HIGH>
        , <&nrf52840 1 GPIO_ACTIVE_HIGH>
        ;
};
&default_transform { // Offset of 3 because the left side has 3 columns
    col-offset = <7>;
};
&ec11_transform { // Offset of 3 because the left side has 3 columns
    col-offset = <7>;
};

